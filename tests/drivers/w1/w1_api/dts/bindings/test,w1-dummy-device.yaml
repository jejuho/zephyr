## tests/drivers/w1/w1_api/dts/bindings/test,w1-dummy-device.yaml
```yaml
# Copyright (c) 2021, Thomas Stranger
# SPDX-License-Identifier: Apache-2.0

description: 1-Wire dummy device

compatible: "w1-dummy-device"

include: w1-device.yaml
```

## tests/drivers/w1/w1_api/testcase.yaml
```yaml
common:
  tags: drivers w1
  harness: ztest
  harness_config:
    fixture: w1_serial_idle
tests:
  drivers.w1.w1-serial:
    filter: dt_compat_enabled("zephyr,w1-serial")
    platform_allow: nucleo_g0b1re
  drivers.w1.w1-serial-arduino:
    depends_on: arduino_serial
    extra_args: DTC_OVERLAY_FILE=arduino_serial.overlay
    platform_allow: nucleo_g071rb
```
