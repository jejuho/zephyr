/*
 * Copyright (c) 2021 Thomas Stranger
 *
 * SPDX-License-Identifier: Apache-2.0
 */

&arduino_serial {
	status = "okay";

	w1_test_0: w1-zephyr-serial-0 {
		compatible = "zephyr,w1-serial";
		#address-cells = <1>;
		#size-cells = <0>;
		label = "W1_TEST";
		status = "okay";

		dummy-device-1@28 {
			compatible = "w1-dummy-device";
			reg = <0x28>;
			label = "DUMMY_DEVICE_1";
			status = "okay";
		};

		dummy-device-2@29 {
			compatible = "w1-dummy-device";
			reg = <0x29>;
			label = "DUMMY_DEVICE_2";
			status = "okay";
		};
	};
};
